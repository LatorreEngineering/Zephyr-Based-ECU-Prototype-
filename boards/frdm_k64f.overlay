/* SPDX-License-Identifier: Apache-2.0 */
/* FRDM-K64F Device Tree Overlay for Zephyr ECU Prototype */

/* FlexCAN0 - CAN bus configuration for Zephyr v3.7+ */
&flexcan0 {
    status = "okay";
    bitrate = <500000>;
};

/* UART3 - LIN bus at 19200 baud */
&uart3 {
    status = "okay";
    current-speed = <19200>;
};
